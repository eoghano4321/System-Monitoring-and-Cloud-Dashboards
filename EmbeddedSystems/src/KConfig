## EmbeddedSystems/src/KConfig
```kconfig
menu "Socket Configuration"

    config ESP_WIFI_SSID
        string "WiFi SSID"
        default "myssid"
        help
            SSID (network name) for the example to connect to.

    config ESP_WIFI_PASSWORD
        string "WiFi Password"
        default "mypassword"
        help
            WiFi password (WPA or WPA2) for the example to use.

    choice ESP_WIFI_SAE_MODE
        prompt "WPA3 SAE mode selection"
        default ESP_WPA3_SAE_PWE_BOTH
        help
            Select mode for SAE as Hunt and Peck, H2E or both.
        config ESP_WPA3_SAE_PWE_HUNT_AND_PECK
            bool "HUNT AND PECK"
        config ESP_WPA3_SAE_PWE_HASH_TO_ELEMENT
            bool "H2E"
        config ESP_WPA3_SAE_PWE_BOTH
            bool "BOTH"
    endchoice

    config ESP_WIFI_PW_ID
        string "PASSWORD IDENTIFIER"
        depends on  ESP_WPA3_SAE_PWE_HASH_TO_ELEMENT|| ESP_WPA3_SAE_PWE_BOTH
        default ""
        help
            password identifier for SAE H2E

    config ESP_MAXIMUM_RETRY
        int "Maximum retry"
        default 10
        help
            Set the Maximum retry to avoid station reconnecting to the AP unlimited when the AP is really inexistent.

    config SERVER_IP
        string "Server IP Address"
        default "192.168.197.19"
        help
            IP address of the server to connect to.

    config SERVER_PORT
        int "Server Port"
        default 5665
        help
            Port number of the server to connect to.

endmenu

menu "System Configuration"
    config GAS_ALARM_THRESHOLD
        int "Gas Alarm Threshold"
        default 3000
        help
            What value to trigger the Alarm
    config DEVICE_NAME
        string "Device Name"
        default "ESP32_DEVICE"
        help
            Name of the device
endmenu
```
